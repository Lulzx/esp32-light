## main/Kconfig.projbuild
```kconfig
menu "WiFi Configuration"

    config WIFI_SSID
        string "WiFi SSID"
        default "your_ssid"
        help
            WiFi network name.

    config WIFI_PASSWORD
        string "WiFi Password"
        default "your_password"
        help
            WiFi network password.

endmenu

menu "Telegram Bot"

    config TELEGRAM_BOT_TOKEN
        string "Bot Token"
        default "your_bot_token"
        help
            Telegram bot token from @BotFather.

endmenu
```
